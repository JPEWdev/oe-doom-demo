## meta-doom-demo/conf/layer.conf
```bitbake
# Copyright (C) 2020 Joshua Watt <JPEWhacker@gmail.com>
# Released under the MIT license (see COPYING.MIT for the terms)

# We have a conf and classes directory, append to BBPATH
BBPATH .= ":${LAYERDIR}"

# We have a recipes directory containing .bb and .bbappend files, add to BBFILES
BBFILES += "${LAYERDIR}/recipes*/*/*.bb \
            ${LAYERDIR}/recipes*/*/*.bbappend"

BBFILE_COLLECTIONS += "doom-demo"
BBFILE_PATTERN_doom-demo := "^${LAYERDIR}/"
BBFILE_PRIORITY_doom-demo = "9"

# This should only be incremented on significant changes that will
# cause compatibility issues with other layers
LAYERVERSION_doom-demo = "1"
LAYERSERIES_COMPAT_doom-demo = "mickledore kirkstone"
LAYERDEPENDS_doom-demo = "core doom"
```
